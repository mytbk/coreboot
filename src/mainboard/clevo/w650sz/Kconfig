## src/mainboard/clevo/w650sz/Kconfig
```kconfig
if BOARD_CLEVO_W650SZ

config BOARD_SPECIFIC_OPTIONS
	def_bool y
	select BOARD_ROMSIZE_KB_6144
	select CPU_INTEL_HASWELL
	select EC_ACPI
	select HAVE_ACPI_RESUME
	select HAVE_ACPI_TABLES
	select INTEL_INT15
	select MAINBOARD_HAS_LIBGFXINIT
	select NORTHBRIDGE_INTEL_HASWELL
	select SERIRQ_CONTINUOUS_MODE
	select SOUTHBRIDGE_INTEL_LYNXPOINT
	select SYSTEM_TYPE_LAPTOP
	select TSC_MONOTONIC_TIMER

config MAINBOARD_DIR
	string
	default clevo/w650sz

config MAINBOARD_PART_NUMBER
	string
	default "W650SZ"

config VGA_BIOS_FILE
	string
	default "pci8086,0416.rom"

config VGA_BIOS_ID
	string
	default "8086,0416"

config MAX_CPUS
	int
	default 8

config USBDEBUG_HCD_INDEX
	int
	default 2

endif
```

## src/mainboard/hp/820g2/Kconfig
```kconfig
if BOARD_HP_820_G2

config BOARD_SPECIFIC_OPTIONS
	def_bool y
	select BOARD_ROMSIZE_KB_12288
	select EC_HP_KBC1126
	select HAVE_ACPI_RESUME
	select HAVE_ACPI_TABLES
	select INTEL_INT15
	select MAINBOARD_HAS_LIBGFXINIT
	select MAINBOARD_HAS_LPC_TPM
	select MAINBOARD_HAS_TPM1
	select MAINBOARD_USES_IFD_GBE_REGION
	select SOC_INTEL_BROADWELL
	select SYSTEM_TYPE_LAPTOP

config MAINBOARD_DIR
	string
	default "hp/820g2"

config MAINBOARD_PART_NUMBER
	string
	default "EliteBook 820 G2"

config VGA_BIOS_FILE
	string
	default "pci8086,1616.rom"

config VGA_BIOS_ID
	string
	default "8086,1616"

config EC_HP_KBC1126_ECFW_IN_CBFS
	bool
	default n

config EC_HP_KBC1126_GPE
	hex
	default 0x6

endif
```
